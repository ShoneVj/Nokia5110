/*Nokia.cpp - Simple example in creating your own Arduino Library
 
*/
 
#include <Arduino.h>
#include "Nokia5110.h"
 
Nokia5110::Nokia5110(int rst, int ce,int dc, int din, int clk){
 pinMode(rst,OUTPUT);
 pinMode(ce,OUTPUT);
 pinMode(dc,OUTPUT);
 pinMode(din,OUTPUT);
 pinMode(clk,OUTPUT);
 RST=rst;CE=ce;DC=dc;DIN=din;CLK=clk; 
 Invert_status=false;
 
}
 
void Nokia5110::Cmd(unsigned char c){
  unsigned int i;
  digitalWrite(DC,LOW);
  digitalWrite(CE,LOW);
  for(i=0;i<8;i++){
    digitalWrite(CLK,LOW);
    if(c&0x80)
      digitalWrite(DIN,HIGH);
    else 
      digitalWrite(DIN,LOW);
    digitalWrite(CLK,HIGH);
    c <<= 1;
  }
  digitalWrite(CE,HIGH);
}
 
void Nokia5110::Data(unsigned char d){
 unsigned int i;
  digitalWrite(DC,HIGH);
  digitalWrite(CE,LOW);
  for(i=0;i<8;i++){
    digitalWrite(CLK,LOW);
    if(Invert_status==false){
    if(d&0x80)
      digitalWrite(DIN,HIGH);
    else 
      digitalWrite(DIN,LOW);}
    if(Invert_status==true){
    if(d&0x80)
      digitalWrite(DIN,LOW);
    else 
      digitalWrite(DIN,HIGH);}
    digitalWrite(CLK,HIGH);
    d <<= 1;
  }
  digitalWrite(CE,HIGH);
}

void Nokia5110::Invert(boolean inv){
  Invert_status=inv;
}


void Nokia5110::dotPixel(unsigned char x,unsigned char y){
  Cmd(0x40|(y&0x07));
  Cmd(0x80|(x&0x7f));
}

void Nokia5110::allClear(void){
  int pixel;
  dotPixel(0,0);                  
  for (pixel=504;pixel>0;pixel--) {Data(0x00);}  
}

void Nokia5110::Initialize_LCD(void)
{
  digitalWrite(RST,HIGH);  
  digitalWrite(CE,HIGH); 


  Cmd(0x21);    
  Cmd(0xb2);    
  Cmd(0x13);  
  Cmd(0x20);    
  Cmd(0x09);    
  allClear();   
  Cmd(0x08);    
  Cmd(0x0C);  
  dotPixel(0,0);    
}

void Nokia5110::setPointer(unsigned char row,unsigned char col){
  if((row>6) || (row<1) || (col<1) || (col>14))
    return;
  dotPixel(((col-1)*6),(row-1));
}

void Nokia5110::charDisp(unsigned char ch){
  unsigned char i, b;

const char LookUpTable [93][5] =
{
    { 0x00, 0x00, 0x00, 0x00, 0x00 }, 
    { 0x00, 0x00, 0x2f, 0x00, 0x00 },   
    { 0x00, 0x07, 0x00, 0x07, 0x00 },  
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    { 0x00, 0x08, 0x3e, 0x41, 0x00 }   
};




  if ( (ch < 0x20) || (ch > 0x7c) ){
    ch = 93;
  }
  for(i=0;i<5;i++){
    b = LookUpTable[ch - 32][i] << 1;
    Data(b);
  }
  Data(0x00);
}

void Nokia5110::strDisp(unsigned char *p){
  while(*p!='\0')
    charDisp(*p++);
}


void Nokia5110::logoDisp(unsigned char logo[])
{
  unsigned int i;
  
  dotPixel(0,0);
  for(i=0;i<504;i++)
  Data(logo[i]);  
}